## boards/shields/dax6/Kconfig.defconfig
```kconfig
if SHIELD_DAX6_R

config ZMK_KEYBOARD_NAME
  default "dax6_R"

config ZMK_SPLIT_ROLE_CENTRAL
  default y

endif

if SHIELD_DAX6_L

config ZMK_KEYBOARD_NAME
  default "dax6_L"

endif

if SHIELD_DAX6_R || SHIELD_DAX6_L

config ZMK_SPLIT
  default y

endif
```

## boards/shields/dax6/Kconfig.shield
```kconfig
config SHIELD_DAX6_R
  def_bool $(shields_list_contains,dax6_R)

config SHIELD_DAX6_L
  def_bool $(shields_list_contains,dax6_L)
```

## config/west.yml
```yaml
manifest:
  remotes:
    - name: zmkfirmware
      url-base: https://github.com/zmkfirmware
    - name: cormoran
      url-base: https://github.com/cormoran
    - name: caksoylar
      url-base: https://github.com/caksoylar
    - name: kot149
      url-base: https://github.com/kot149
    - name: sekigon-gonnoc
      url-base: https://github.com/sekigon-gonnoc
  projects:
    - name: zmk
      remote: cormoran
      revision: 1fc72aaff7a42bd533c1f4c9b3f23c5317c745f4  # main+custom-studio-protocol as of 2026-07-22 (ZMK main + custom Studio RPC)
      import: app/west.yml
    - name: zmk-behavior-runtime-sensor-rotate
      remote: cormoran
      revision: 8b1125ed  # main as of 2026-07-06, CI-tested against v0.3-branch+custom-studio-protocol
    - name: zmk-driver-paw3222
      remote: sekigon-gonnoc
      revision: df652881  # Last version compatible with ZMK v0.3 (PAW3222 driver, verified 2026-06-15)
    - name: zmk-rgbled-widget
      remote: caksoylar
      revision: e6b467792a1dabef8cfa5c9fd26bfefc9c16662b  # main as of 2026-07-09
    - name: zmk-mouse-gesture
      remote: kot149
      revision: v1
  self:
    path: config
```
